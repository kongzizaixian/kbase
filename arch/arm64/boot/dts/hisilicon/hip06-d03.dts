/**
 * dts file for Hisilicon D03 Development Board
 *
 * Copyright (C) 2014,2015 Hisilicon Ltd.
 *
 * This program is free software; you can redistribute it and/or modify
 * it under the terms of the GNU General Public License version 2 as
 * publishhed by the Free Software Foundation.
 *
 */

/dts-v1/;

/memreserve/ 0x00000000 0x00010000;
/include/ "hip06.dtsi"

/ {
	model = "Hisilicon Hip06 D03 Development Board";
	compatible = "hisilicon,hip06-d03";

	memory@00000000 {
		device_type = "memory";
		reg = <0x0 0x0 0x0 0x40000000>;
	};

	chosen {
		bootargs = "console=ttyS1,115200 earlycon=hisilpcuart,mmio,0xa01b0000,0,0x2f8 initrd=0x7000000,500M";
	};
};
